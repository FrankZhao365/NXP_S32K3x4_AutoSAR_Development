AUTOSAR XML (schema 00045)
package /ActiveEcuC
  module config vSet: implementation-config-variant=VARIANT-PRE-COMPILE, module-description=vSet_Impl
    vSetGeneral: vSetDummyStatementKind=SelfAssignment
    vSetPlatform:
      vSetSizeOfROMPointer = Size32Bit
      vSetSizeOfRAMPointer = Size32Bit
      vSetByteOrder = LITTLE_ENDIAN
      vSetCPUType = CPU32Bit
      vSetSizeOfEnum = Size32Bit
      vSetSizeOfInt = Size32Bit
      vSetBitOrder = LSB_to_MSB
    vSetCalibration
