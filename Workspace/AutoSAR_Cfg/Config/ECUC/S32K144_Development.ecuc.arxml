AUTOSAR XML (schema 00045)
package /ActiveEcuC
  ecuc value collection ActiveEcuC: ecu-extract=SYSTEM, ecuc-values=[Port, Dio, Base, Resource, Mcu, vSet, BswM, Det, EcuM, Os, Rte, EcuC]
