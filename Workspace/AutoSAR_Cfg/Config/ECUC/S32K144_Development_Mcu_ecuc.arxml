AUTOSAR XML (schema 00045)
package /Mcu
  module config Mcu: implementation-config-variant=VARIANT-POST-BUILD, module-description=Mcu_Impl
    CommonPublishedInformation:
      ArReleaseMajorVersion = 4
      ArReleaseMinorVersion = 2
      ArReleaseRevisionVersion = 2
      ModuleId = 101
      SwMajorVersion = 1
      SwMinorVersion = 0
      SwPatchVersion = 1
      VendorApiInfix = 
      VendorId = 43
    McuDebugConfiguration: McuDisableCmuApi=false, McuDisableDemReportErrorStatus=false, McuEnablePeripheralCMU=false, McuGetMidrStructureApi=false, McuGetPeriphStateApi=false
    McuGeneralConfiguration:
      McuCalloutBeforePerformReset = false
      McuDevErrorDetect = false
      McuEnableUserModeSupport = false
      McuEnterLowPowerMode = false
      McuGetRamStateApi = false
      McuInitClock = true
      McuNoPll = true
      McuPerformResetApi = false
      McuPerformResetCallout = NULL_PTR
      McuTimeout = 50000
      McuVersionInfoApi = false
    McuModuleConfiguration:
      McuClockSrcFailureNotification = ENABLED
      McuLPO1KClockEnable = true
      McuLPO32KClockEnable = true
      McuLPOClockSelect = LPO_CLK_128K
      McuNumberOfMcuModes = 1
      McuRTCCLKINFrequencyHz = 32000
      McuRamSectors = 0
      McuRtcClkSelect = SOSCDIV1_CLK
      McuAllowedModes: McuAllowHighSpeedRunMode=false, McuAllowVeryLowPowerModes=false
      McuClockSettingConfig_0 (McuClockSettingConfig): McuClockSettingId=0, McuScgClkOutSelect=SCG_SLOW_CLK, McuSysClockUnderMcuControl=true
        McuClkMonitor_0:
          McuClkMonitorEn = false
          McuFrequencyHigherInterrupt = false
          McuFrequencyLowerInterrupt = false
          McuHighFrequencyRef = 16777215
          McuLowFrequencyRef = 0
          McuReferenceCountConfiguration = 65535
        McuClkMonitor_1:
          McuClkMonitorEn = false
          McuFrequencyHigherInterrupt = false
          McuFrequencyLowerInterrupt = false
          McuHighFrequencyRef = 16777215
          McuLowFrequencyRef = 0
          McuReferenceCountConfiguration = 65535
        McuClockReferencePoint_0 (McuClockReferencePoint): McuClockFrequencySelect=RUN_SYS_CLK, McuClockReferencePointFrequency=48000000
        McuFIRCClockConfig:
          McuFIRCDiv1 = 1
          McuFIRCDiv1Frequency = 48000000
          McuFIRCDiv2 = 2
          McuFIRCDiv2Frequency = 24000000
          McuFIRCEnable = true
          McuFIRCFrequency = 48000000
          McuFIRCRangeSelect = TRIMMED_TO_48MHZ
          McuFIRCRegulatorEnable = false
          McuFIRCUnderMcuControl = true
        McuHsrunClockConfig:
          McuBusClockDivider = 1
          McuBusClockFrequency = 48000000
          McuCoreClockDivider = 1
          McuCoreClockFrequency = 48000000
          McuFlashClockFrequency = 24000000
          McuPreDivSystemClockFrequency = 48000000
          McuScgClkOutFrequency = 24000000
          McuSlowClockDivider = 2
          McuSystemClockFrequency = 48000000
          McuSystemClockSwitch = FIRC
        32 x McuPeripheralClockConfig, all with McuPeripheralClockDivider=1, McuPeripheralClockEnable=true, McuPeripheralClockFrequency=0, McuPeripheralClockSelect=EXT_CLK_OR_CLK_OFF, McuPeripheralFractionalDivider=0:
          McuPeripheralClockConfig_0: McuPerName=FTFC
          McuPeripheralClockConfig_1: McuPerName=DMAMUX0
          McuPeripheralClockConfig_10: McuPerName=PDB1
          McuPeripheralClockConfig_11: McuPerName=CRC
          McuPeripheralClockConfig_12: McuPerName=PDB0
          McuPeripheralClockConfig_13: McuPerName=LPIT
          McuPeripheralClockConfig_14: McuPerName=FTM0
          McuPeripheralClockConfig_15: McuPerName=FTM1
          McuPeripheralClockConfig_16: McuPerName=FTM2
          McuPeripheralClockConfig_17: McuPerName=ADC0
          McuPeripheralClockConfig_18: McuPerName=RTC
          McuPeripheralClockConfig_19: McuPerName=LPTMR0
          McuPeripheralClockConfig_2: McuPerName=FLEXCAN0
          McuPeripheralClockConfig_20: McuPerName=PORTA
          McuPeripheralClockConfig_21: McuPerName=PORTB
          McuPeripheralClockConfig_22: McuPerName=PORTC
          McuPeripheralClockConfig_23: McuPerName=PORTD
          McuPeripheralClockConfig_24: McuPerName=PORTE
          McuPeripheralClockConfig_25: McuPerName=FLEXIO
          McuPeripheralClockConfig_26: McuPerName=EWM
          McuPeripheralClockConfig_27: McuPerName=LPI2C0
          McuPeripheralClockConfig_28: McuPerName=LPUART0
          McuPeripheralClockConfig_29: McuPerName=LPUART1
          McuPeripheralClockConfig_3: McuPerName=FLEXCAN1
          McuPeripheralClockConfig_30: McuPerName=LPUART2
          McuPeripheralClockConfig_31: McuPerName=CMP0
          McuPeripheralClockConfig_4: McuPerName=FTM3
          McuPeripheralClockConfig_5: McuPerName=ADC1
          McuPeripheralClockConfig_6: McuPerName=FLEXCAN2
          McuPeripheralClockConfig_7: McuPerName=LPSPI0
          McuPeripheralClockConfig_8: McuPerName=LPSPI1
          McuPeripheralClockConfig_9: McuPerName=LPSPI2
        McuRunClockConfig:
          McuBusClockDivider = 1
          McuBusClockFrequency = 48000000
          McuCoreClockDivider = 1
          McuCoreClockFrequency = 48000000
          McuFlashClockFrequency = 24000000
          McuPreDivSystemClockFrequency = 48000000
          McuScgClkOutFrequency = 24000000
          McuSlowClockDivider = 2
          McuSystemClockFrequency = 48000000
          McuSystemClockSwitch = FIRC
        McuSIMClockConfig:
          McuClockOutDivider = 1
          McuClockOutEnable = false
          McuClockOutSelect = SCG_CLKOUT
          McuDMAClockGatingEnable = true
          McuDebugTraceDividerEnable = true
          McuEIMClockGatingEnable = true
          McuERMClockGatingEnable = true
          McuGPIOClockGatingEnable = false
          McuMPUClockGatingEnable = true
          McuMSCMClockGatingEnable = true
          McuTraceClockDivider = 1
          McuTraceClockFraction = 0
          McuTraceClockSelect = CORE_CLK
        McuSIRCClockConfig:
          McuSIRCDiv1 = 1
          McuSIRCDiv1Frequency = 8000000
          McuSIRCDiv2 = 2
          McuSIRCDiv2Frequency = 4000000
          McuSIRCEnable = true
          McuSIRCFrequency = 8000000
          McuSIRCLowPowerEnable = false
          McuSIRCRangeSelect = HIGH_RANGE_CLOCK
          McuSIRCStopEnable = false
          McuSIRCUnderMcuControl = true
        McuSystemOSCClockConfig:
          McuSOSCClockMonitorEnable = false
          McuSOSCClockMonitorResetEnable = false
          McuSOSCDiv1 = 1
          McuSOSCDiv1Frequency = 8000000
          McuSOSCDiv2 = 1
          McuSOSCDiv2Frequency = 8000000
          McuSOSCEnable = true
          McuSOSCExternalReferenceSelect = false
          McuSOSCFrequency = 8000000
          McuSOSCHighGainOscillatorSelect = false
          McuSOSCRangeSelect = HIGH_FREQ_RANGE
          McuSOSCUnderMcuControl = true
        McuSystemPll:
          McuSPLLClockMonitorEnable = false
          McuSPLLClockMonitorResetEnable = false
          McuSPLLDiv1 = 1
          McuSPLLDiv1Frequency = 96000000
          McuSPLLDiv2 = 2
          McuSPLLDiv2Frequency = 48000000
          McuSPLLEnable = false
          McuSPLLFrequency = 96000000
          McuSPLLInputClkPreDivider = 1
          McuSPLLInputFrequency = 8000000
          McuSPLLMultiplier = 24
          McuSystemPllUnderMcuControl = false
        McuVlprClockConfig:
          McuBusClockDivider = 1
          McuBusClockFrequency = 4000000
          McuCoreClockDivider = 2
          McuCoreClockFrequency = 4000000
          McuFlashClockFrequency = 1000000
          McuPreDivSystemClockFrequency = 8000000
          McuScgClkOutFrequency = 1000000
          McuSlowClockDivider = 4
          McuSystemClockFrequency = 4000000
          McuSystemClockSwitch = SIRC
      McuInterruptEvents: McuAlternateResetEvent=false, McuVoltageErrorEvent=false
      McuModeSettingConf_0 (McuModeSettingConf): McuMode=0, McuPowerMode=RUN
      McuPowerControl:
        McuClockBiasDisable = false
        McuLPODisable = false
        McuLowPowerBiasEnable = false
        McuLowVoltageDetectInterruptEnable = false
        McuLowVoltageDetectResetEnable = false
        McuLowVoltageWarningInterruptEnable = false
        McuLpoTrimming = 0
      McuResetConfig: McuResetPinFilterBusClockSelect=0, McuResetPinFilterInRunAndWait=ALL_FILTERING_DISABLE, McuResetPinFilterInStopMode=ALL_FILTERING_DISABLE
        McuSystemInterruptEnable:
          McuCMULossOfClockResetInterrupt = false
          McuCoreLockupInterrupt = false
          McuExternalResetPinInterrupt = false
          McuGlobalInterrupt = false
          McuJTAGResetInterrupt = false
          McuLossOfClockInterrupt = false
          McuLossOfLockInterrupt = false
          McuMDMAPSystemResetInterrupt = false
          McuResetDelayTime = DELAY_10_LPO_CYCLES
          McuSoftwareInterrupt = false
          McuStopAcknowledgeErrorInterrupt = false
          McuWatchdogInterrupt = false
      McuSIMConfig
        McuAdcOptionsConfiguration:
          McuADC0PreTrigeerSourceSelect = PDB_PRE_TRIGGER
          McuADC0SoftwarePreTrigeerSourceSelect = SW_PRE_TRIGGER_DISABLE
          McuADC0TrigeerSourceSelect = PDB
          McuADC1PreTrigeerSourceSelect = PDB_PRE_TRIGGER
          McuADC1SoftwarePreTrigeerSourceSelect = SW_PRE_TRIGGER_DISABLE
          McuADC1TrigeerSourceSelect = PDB
          McuSoftwareTriggerToTRGMUX = false
        McuChipControlConfiguration:
          McuAdcSupply = VDD
          McuEnableAdcSupplyMonitoring = false
          McuPDBBackToBackSelect = false
          McuPTB0InterleaveChannelSelect = false
          McuPTB13InterleaveChannelSelect = false
          McuPTB14InterleaveChannelSelect = false
          McuPTB1InterleaveChannelSelect = false
        McuFlexTimerConfiguration:
          McuFTM0Ch{0..7}ModulationSelect = false
          McuFTM0ExternalClockPinSelect = TCLK0_PIN
          McuFTM0Fault{0..2}Select = FTM0_FLT{0..2}_PIN
          McuFTM0OBEControl = false
          McuFTM0SyncBit = false
          McuFTM1Ch0InputSelect = FTM1_CH0_INPUT
          McuFTM1ExternalClockPinSelect = TCLK0_PIN
          McuFTM1Fault{0..2}Select = FTM1_FLT{0..2}_PIN
          McuFTM1OBEControl = false
          McuFTM1SyncBit = false
          McuFTM2Ch0InputSelect = FTM2_CH0_INPUT
          McuFTM2Ch1InputSelect = FTM2_CHI1_INPUT
          McuFTM2ExternalClockPinSelect = TCLK0_PIN
          McuFTM2Fault{0..2}Select = FTM2_FLT{0..2}_PIN
          McuFTM2OBEControl = false
          McuFTM2SyncBit = false
          McuFTM3Ch{0..7}ModulationSelect = false
          McuFTM3ExternalClockPinSelect = TCLK0_PIN
          McuFTM3Fault{0..2}Select = FTM3_FLT{0..2}_PIN
          McuFTM3OBEControl = false
          McuFTM3SyncBit = false
          McuFTM4ExternalClockPinSelect = TCLK0_PIN
          McuFTM4OBEControl = false
          McuFTM4SyncBit = false
          McuFTM5ExternalClockPinSelect = TCLK0_PIN
          McuFTM5OBEControl = false
          McuFTM5SyncBit = false
          McuFTM6ExternalClockPinSelect = TCLK0_PIN
          McuFTM6OBEControl = false
          McuFTM6SyncBit = false
          McuFTM7ExternalClockPinSelect = TCLK0_PIN
          McuFTM7OBEControl = false
          McuFTM7SyncBit = false
          McuFTMGlobalLoadEnable = false
          McuFTM_GTBControl = false
          McuQspiClkSelect = false
          McuRMII_ClkSelect = false
          McuRMII_Clk_OBE = false
    McuPublishedInformation
      15 x McuResetReasonConf:
        MCU_CMU_LOC_RESET: McuResetReason=14
        MCU_CORE_LOCKUP_RESET: McuResetReason=3
        MCU_EXTERNAL_PIN_RESET: McuResetReason=6
        MCU_JTAG_RESET: McuResetReason=4
        MCU_LOSS_OF_CLOCK_RESET: McuResetReason=9
        MCU_LOSS_OF_LOCK_RESET: McuResetReason=8
        MCU_LOW_OR_HIGH_VOLTAGE_DETECT_RESET: McuResetReason=10
        MCU_MDM_AP_SYSTEM_RESET: McuResetReason=1
        MCU_MULTIPLE_RESET_REASON: McuResetReason=12
        MCU_NO_RESET_REASON: McuResetReason=11
        MCU_POWER_ON_RESET: McuResetReason=5
        MCU_RESET_UNDEFINED: McuResetReason=13
        MCU_STOP_ACKNOWLEDGE_ERROR_RESET: McuResetReason=0
        MCU_SW_RESET: McuResetReason=2
        MCU_WATCHDOG_RESET: McuResetReason=7
