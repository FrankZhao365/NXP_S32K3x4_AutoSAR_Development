AUTOSAR XML (schema 00044)
package /ComponentTypes
  application sw component type Ct_LEDctrl
    behavior Ct_LEDctrl_InternalBehavior
      timing event TMT_Ct_LEDctrl_Runnable: start-on-event=Ct_LEDctrl_Runnable, period=0.01
      init event Ct_LEDctrl_InitEvent: start-on-event=Ct_LEDctrl_Init
      runnable Ct_LEDctrl_Runnable
      runnable Ct_LEDctrl_Init
  swc implementation Ct_LEDctrl_Implementation: behavior=Ct_LEDctrl_InternalBehavior
