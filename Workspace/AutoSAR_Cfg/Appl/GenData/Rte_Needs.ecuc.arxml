AUTOSAR XML (schema 4-0-3)
package /DaVinci_Project
  module config Rte
    6 x RteBswModuleInstance:
      BswM
        BswM_MainFunctionTimingEvent0 (RteBswEventToTaskMapping): RteBswUsedOsEventRef=Rte_Ev_Cyclic2_OsTask_BSW_0_10ms, RteBswUsedOsAlarmRef=Os/Rte_Al_TE2_OsTask_BSW_0_10ms
      Det
      Dio
      EcuM
        EcuM_MainFunctionTimingEvent0 (RteBswEventToTaskMapping): RteBswUsedOsEventRef=Rte_Ev_Cyclic2_OsTask_BSW_0_10ms, RteBswUsedOsAlarmRef=Os/Rte_Al_TE2_OsTask_BSW_0_10ms
      Mcu
      Port
    5 x RteSwComponentInstance:
      BswM_EcuSwComposition
        Timer_BswM_MainFunction (RteEventToTaskMapping): RteUsedOsEventRef=Rte_Ev_Cyclic2_OsTask_BSW_0_10ms, RteUsedOsAlarmRef=Os/Rte_Al_TE2_OsTask_BSW_0_10ms
      Ct_LEDctrl_EcuSwComposition
        TMT_Ct_LEDctrl_Runnable (RteEventToTaskMapping): RteUsedOsEventRef=Rte_Ev_Run_Ct_LEDctrl_Ct_LEDctrl_Runnable, RteUsedOsAlarmRef=Os/Rte_Al_TE_Ct_LEDctrl_Ct_LEDctrl_Runnable
      Det_EcuSwComposition
      EcuM_EcuSwComposition
        Timer_EcuM_MainFunction (RteEventToTaskMapping): RteUsedOsEventRef=Rte_Ev_Cyclic2_OsTask_BSW_0_10ms, RteUsedOsAlarmRef=Os/Rte_Al_TE2_OsTask_BSW_0_10ms
      Os_OsCore0_swc_EcuSwComposition
    RteOsInteraction
      Rte_Al_TE_Ct_LEDctrl_Ct_LEDctrl_Runnable (RteUsedOsActivation): RteExpectedActivationOffset=0, RteActivationOsAlarmRef=Os/Rte_Al_TE_Ct_LEDctrl_Ct_LEDctrl_Runnable, RteActivationOsTaskRef=OsTask_APP
      Rte_Al_TE2_OsTask_BSW_0_10ms (RteUsedOsActivation): RteExpectedActivationOffset=0, RteActivationOsAlarmRef=Os/Rte_Al_TE2_OsTask_BSW_0_10ms, RteActivationOsTaskRef=OsTask_BSW
  module config NvM
  module config Os
    OsTask_APP (OsTask): OsTaskActivation=1, OsTaskPriority=15, OsTaskSchedule=NON, OsTaskEventRef=Rte_Ev_Run_Ct_LEDctrl_Ct_LEDctrl_Runnable
    Rte_Al_TE_Ct_LEDctrl_Ct_LEDctrl_Runnable (OsAlarm): OsAlarmCounterRef=SystemTimer
      OsAlarmAction
        OsAlarmSetEvent: OsAlarmSetEventRef=Rte_Ev_Run_Ct_LEDctrl_Ct_LEDctrl_Runnable, OsAlarmSetEventTaskRef=OsTask_APP
    OsTask_BSW (OsTask): OsTaskActivation=1, OsTaskPriority=10, OsTaskSchedule=NON, OsTaskEventRef=Rte_Ev_Cyclic2_OsTask_BSW_0_10ms
    Rte_Al_TE2_OsTask_BSW_0_10ms (OsAlarm): OsAlarmCounterRef=SystemTimer
      OsAlarmAction
        OsAlarmSetEvent: OsAlarmSetEventRef=Rte_Ev_Cyclic2_OsTask_BSW_0_10ms, OsAlarmSetEventTaskRef=OsTask_BSW
    Rte_Ev_Cyclic2_OsTask_BSW_0_10ms (OsEvent)
    Rte_Ev_Run_Ct_LEDctrl_Ct_LEDctrl_Runnable (OsEvent)
  module config EcuC
  ecuc value collection DaVinci_Project: ecuc-values=[Com, Rte, Os, EcuC, NvM]
