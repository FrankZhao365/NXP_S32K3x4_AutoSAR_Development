AUTOSAR XML (schema 4-2-2)
package /Port
  module config Port: implementation-config-variant=VARIANT-POST-BUILD
    CommonPublishedInformation:
      ArReleaseMajorVersion = 4
      ArReleaseMinorVersion = 2
      ArReleaseRevisionVersion = 2
      ModuleId = 124
      SwMajorVersion = 1
      SwMinorVersion = 0
      SwPatchVersion = 1
      VendorId = 43
    PortConfigSet
      NotUsedPortPin: PortPinDSE=Low_Drive_Strength, PortPinDirection=PORT_PIN_IN, PortPinLevelValue=PORT_PIN_LEVEL_LOW, PortPinPE=PullDisabled, PortPinPS=PullDown
      PortContainer_Debug (PortContainer): PortNumberOfPortPins=4
        4 x PortPin, all with PortPinDSE=Low_drive_strength, PortPinDirection=PORT_PIN_IN, PortPinDirectionChangeable=1, PortPinInitialMode=PORT_GPIO_MODE, PortPinLevelValue=PORT_PIN_LEVEL_LOW, PortPinModeChangeable=1, PortPinPFE=0:
          PIN_JTAG_SW_DIO_PTA4: PortPinId=6, PortPinMode=JTAG_TMS_SWD_DIO, PortPinPE=PullEnabled, PortPinPS=PullUp, PortPinPcr=4
          PIN_JTAG_TCK_SWD_CLK_PTC4: PortPinId=7, PortPinMode=JTAG_TCLK_SWD_CLK, PortPinPE=PullEnabled, PortPinPS=PullUp, PortPinPcr=68
          PIN_JTAG_TDI_PTC5: PortPinId=5, PortPinMode=JTAG_TDI, PortPinPE=PullEnabled, PortPinPS=PullUp, PortPinPcr=69
          PIN_JTAG_TDO_PTA10: PortPinId=8, PortPinMode=JTAG_TDO, PortPinPE=PullDisabled, PortPinPS=PullDown, PortPinPcr=10
      PortContainer_LED (PortContainer): PortNumberOfPortPins=4
        4 x PortPin, all with PortPinDSE=Low_drive_strength, PortPinDirection=PORT_PIN_OUT, PortPinDirectionChangeable=1, PortPinInitialMode=PORT_GPIO_MODE, PortPinLevelValue=PORT_PIN_LEVEL_LOW, PortPinMode=GPIO, PortPinModeChangeable=1, PortPinPE=PullDisabled, PortPinPFE=0, PortPinPS=PullDown:
          PortPin_LEDB_PTD0: PortPinId=1, PortPinPcr=96
          PortPin_LEDG_PTD16: PortPinId=4, PortPinPcr=112
          PortPin_LEDR_PTD15: PortPinId=3, PortPinPcr=111
          PortPin_LEDY_PTD1: PortPinId=2, PortPinPcr=97
    PortGeneral:
      PortDevErrorDetect = 1
      PortEnableUserModeSupport = 0
      PortSet2PinsDirectionApi = 0
      PortSetPinDirectionApi = 1
      PortSetPinModeApi = 1
      PortSetPinModeDoesNotTouchGpioLevel = 0
      PortVersionInfoApi = 1
package /Dio
  module config Dio: implementation-config-variant=VARIANT-PRE-COMPILE
    CommonPublishedInformation:
      ArReleaseMajorVersion = 4
      ArReleaseMinorVersion = 2
      ArReleaseRevisionVersion = 2
      ModuleId = 120
      SwMajorVersion = 1
      SwMinorVersion = 0
      SwPatchVersion = 1
      VendorId = 43
    DioConfig
      DioPort_0 (DioPort): DioPortId=0
    DioGeneral:
      DioDevErrorDetect = 0
      DioEnableUserModeSupport = 0
      DioFlipChannelApi = 0
      DioMaskedWritePortApi = 0
      DioReadZeroForUndefinedPortPins = 0
      DioReversePortBits = 0
      DioVersionInfoApi = 0
package /Base
  module config Base
    CommonPublishedInformation:
      ArReleaseMajorVersion = 4
      ArReleaseMinorVersion = 2
      ArReleaseRevisionVersion = 2
      ModuleId = 0
      SwMajorVersion = 1
      SwMinorVersion = 0
      SwPatchVersion = 1
      VendorId = 43
package /Resource
  module config Resource
    CommonPublishedInformation:
      ArReleaseMajorVersion = 4
      ArReleaseMinorVersion = 2
      ArReleaseRevisionVersion = 2
      ModuleId = 0
      SwMajorVersion = 1
      SwMinorVersion = 0
      SwPatchVersion = 1
      VendorId = 43
    ResourceGeneral: ResourceSubderivative=s32k144_lqfp100
package /Mcu
  module config Mcu: implementation-config-variant=VARIANT-POST-BUILD
    CommonPublishedInformation:
      ArReleaseMajorVersion = 4
      ArReleaseMinorVersion = 2
      ArReleaseRevisionVersion = 2
      ModuleId = 101
      SwMajorVersion = 1
      SwMinorVersion = 0
      SwPatchVersion = 1
      VendorApiInfix = 
      VendorId = 43
    McuDebugConfiguration: McuDisableCmuApi=0, McuDisableDemReportErrorStatus=0, McuEnablePeripheralCMU=0, McuGetMidrStructureApi=0, McuGetPeriphStateApi=0
    McuGeneralConfiguration:
      McuCalloutBeforePerformReset = 0
      McuDevErrorDetect = 0
      McuEnableUserModeSupport = 0
      McuEnterLowPowerMode = 0
      McuGetRamStateApi = 0
      McuInitClock = 1
      McuNoPll = 1
      McuPerformResetApi = 0
      McuPerformResetCallout = NULL_PTR
      McuTimeout = 50000
      McuVersionInfoApi = 0
    McuModuleConfiguration:
      McuClockSrcFailureNotification = ENABLED
      McuLPO1KClockEnable = 1
      McuLPO32KClockEnable = 1
      McuLPOClockSelect = LPO_CLK_128K
      McuNumberOfMcuModes = 1
      McuRTCCLKINFrequencyHz = 32000.0
      McuRamSectors = 0
      McuRtcClkSelect = SOSCDIV1_CLK
      McuAllowedModes: McuAllowHighSpeedRunMode=0, McuAllowVeryLowPowerModes=0
      McuClockSettingConfig_0 (McuClockSettingConfig): McuClockSettingId=0, McuScgClkOutSelect=SCG_SLOW_CLK, McuSysClockUnderMcuControl=1
        McuClkMonitor_0:
          McuClkMonitorEn = 0
          McuFrequencyHigherInterrupt = 0
          McuFrequencyLowerInterrupt = 0
          McuHighFrequencyRef = 16777215
          McuLowFrequencyRef = 0
          McuReferenceCountConfiguration = 65535
        McuClkMonitor_1:
          McuClkMonitorEn = 0
          McuFrequencyHigherInterrupt = 0
          McuFrequencyLowerInterrupt = 0
          McuHighFrequencyRef = 16777215
          McuLowFrequencyRef = 0
          McuReferenceCountConfiguration = 65535
        McuClockReferencePoint_0 (McuClockReferencePoint): McuClockFrequencySelect=RUN_SYS_CLK, McuClockReferencePointFrequency=4.8E7
        McuFIRCClockConfig:
          McuFIRCDiv1 = 1
          McuFIRCDiv1Frequency = 4.8E7
          McuFIRCDiv2 = 2
          McuFIRCDiv2Frequency = 2.4E7
          McuFIRCEnable = 1
          McuFIRCFrequency = 4.8E7
          McuFIRCRangeSelect = TRIMMED_TO_48MHZ
          McuFIRCRegulatorEnable = 0
          McuFIRCUnderMcuControl = 1
        McuHsrunClockConfig:
          McuBusClockDivider = 1
          McuBusClockFrequency = 4.8E7
          McuCoreClockDivider = 1
          McuCoreClockFrequency = 4.8E7
          McuFlashClockFrequency = 2.4E7
          McuPreDivSystemClockFrequency = 4.8E7
          McuScgClkOutFrequency = 2.4E7
          McuSlowClockDivider = 2
          McuSystemClockFrequency = 4.8E7
          McuSystemClockSwitch = FIRC
        32 x McuPeripheralClockConfig, all with McuPeripheralClockDivider=1, McuPeripheralClockEnable=1, McuPeripheralClockFrequency=0.0, McuPeripheralClockSelect=EXT_CLK_OR_CLK_OFF, McuPeripheralFractionalDivider=0:
          McuPeripheralClockConfig_0: McuPerName=FTFC
          McuPeripheralClockConfig_1: McuPerName=DMAMUX0
          McuPeripheralClockConfig_10: McuPerName=PDB1
          McuPeripheralClockConfig_11: McuPerName=CRC
          McuPeripheralClockConfig_12: McuPerName=PDB0
          McuPeripheralClockConfig_13: McuPerName=LPIT
          McuPeripheralClockConfig_14: McuPerName=FTM0
          McuPeripheralClockConfig_15: McuPerName=FTM1
          McuPeripheralClockConfig_16: McuPerName=FTM2
          McuPeripheralClockConfig_17: McuPerName=ADC0
          McuPeripheralClockConfig_18: McuPerName=RTC
          McuPeripheralClockConfig_19: McuPerName=LPTMR0
          McuPeripheralClockConfig_2: McuPerName=FLEXCAN0
          McuPeripheralClockConfig_20: McuPerName=PORTA
          McuPeripheralClockConfig_21: McuPerName=PORTB
          McuPeripheralClockConfig_22: McuPerName=PORTC
          McuPeripheralClockConfig_23: McuPerName=PORTD
          McuPeripheralClockConfig_24: McuPerName=PORTE
          McuPeripheralClockConfig_25: McuPerName=FLEXIO
          McuPeripheralClockConfig_26: McuPerName=EWM
          McuPeripheralClockConfig_27: McuPerName=LPI2C0
          McuPeripheralClockConfig_28: McuPerName=LPUART0
          McuPeripheralClockConfig_29: McuPerName=LPUART1
          McuPeripheralClockConfig_3: McuPerName=FLEXCAN1
          McuPeripheralClockConfig_30: McuPerName=LPUART2
          McuPeripheralClockConfig_31: McuPerName=CMP0
          McuPeripheralClockConfig_4: McuPerName=FTM3
          McuPeripheralClockConfig_5: McuPerName=ADC1
          McuPeripheralClockConfig_6: McuPerName=FLEXCAN2
          McuPeripheralClockConfig_7: McuPerName=LPSPI0
          McuPeripheralClockConfig_8: McuPerName=LPSPI1
          McuPeripheralClockConfig_9: McuPerName=LPSPI2
        McuRunClockConfig:
          McuBusClockDivider = 1
          McuBusClockFrequency = 4.8E7
          McuCoreClockDivider = 1
          McuCoreClockFrequency = 4.8E7
          McuFlashClockFrequency = 2.4E7
          McuPreDivSystemClockFrequency = 4.8E7
          McuScgClkOutFrequency = 2.4E7
          McuSlowClockDivider = 2
          McuSystemClockFrequency = 4.8E7
          McuSystemClockSwitch = FIRC
        McuSIMClockConfig:
          McuClockOutDivider = 1
          McuClockOutEnable = 0
          McuClockOutSelect = SCG_CLKOUT
          McuDMAClockGatingEnable = 1
          McuDebugTraceDividerEnable = 1
          McuEIMClockGatingEnable = 1
          McuERMClockGatingEnable = 1
          McuGPIOClockGatingEnable = 0
          McuMPUClockGatingEnable = 1
          McuMSCMClockGatingEnable = 1
          McuTraceClockDivider = 1
          McuTraceClockFraction = 0
          McuTraceClockSelect = CORE_CLK
        McuSIRCClockConfig:
          McuSIRCDiv1 = 1
          McuSIRCDiv1Frequency = 8000000.0
          McuSIRCDiv2 = 2
          McuSIRCDiv2Frequency = 4000000.0
          McuSIRCEnable = 1
          McuSIRCFrequency = 8000000.0
          McuSIRCLowPowerEnable = 0
          McuSIRCRangeSelect = HIGH_RANGE_CLOCK
          McuSIRCStopEnable = 0
          McuSIRCUnderMcuControl = 1
        McuSystemOSCClockConfig:
          McuSOSCClockMonitorEnable = 0
          McuSOSCClockMonitorResetEnable = 0
          McuSOSCDiv1 = 1
          McuSOSCDiv1Frequency = 8000000.0
          McuSOSCDiv2 = 1
          McuSOSCDiv2Frequency = 8000000.0
          McuSOSCEnable = 1
          McuSOSCExternalReferenceSelect = 0
          McuSOSCFrequency = 8000000.0
          McuSOSCHighGainOscillatorSelect = 0
          McuSOSCRangeSelect = HIGH_FREQ_RANGE
          McuSOSCUnderMcuControl = 1
        McuSystemPll:
          McuSPLLClockMonitorEnable = 0
          McuSPLLClockMonitorResetEnable = 0
          McuSPLLDiv1 = 1
          McuSPLLDiv1Frequency = 9.6E7
          McuSPLLDiv2 = 2
          McuSPLLDiv2Frequency = 4.8E7
          McuSPLLEnable = 0
          McuSPLLFrequency = 9.6E7
          McuSPLLInputClkPreDivider = 1
          McuSPLLInputFrequency = 8000000.0
          McuSPLLMultiplier = 24
          McuSystemPllUnderMcuControl = 0
        McuVlprClockConfig:
          McuBusClockDivider = 1
          McuBusClockFrequency = 4000000.0
          McuCoreClockDivider = 2
          McuCoreClockFrequency = 4000000.0
          McuFlashClockFrequency = 1000000.0
          McuPreDivSystemClockFrequency = 8000000.0
          McuScgClkOutFrequency = 1000000.0
          McuSlowClockDivider = 4
          McuSystemClockFrequency = 4000000.0
          McuSystemClockSwitch = SIRC
      McuInterruptEvents: McuAlternateResetEvent=0, McuVoltageErrorEvent=0
      McuModeSettingConf_0 (McuModeSettingConf): McuMode=0, McuPowerMode=RUN
      McuPowerControl:
        McuClockBiasDisable = 0
        McuLPODisable = 0
        McuLowPowerBiasEnable = 0
        McuLowVoltageDetectInterruptEnable = 0
        McuLowVoltageDetectResetEnable = 0
        McuLowVoltageWarningInterruptEnable = 0
        McuLpoTrimming = 0
      McuResetConfig: McuResetPinFilterBusClockSelect=0, McuResetPinFilterInRunAndWait=ALL_FILTERING_DISABLE, McuResetPinFilterInStopMode=ALL_FILTERING_DISABLE
        McuSystemInterruptEnable:
          McuCMULossOfClockResetInterrupt = 0
          McuCoreLockupInterrupt = 0
          McuExternalResetPinInterrupt = 0
          McuGlobalInterrupt = 0
          McuJTAGResetInterrupt = 0
          McuLossOfClockInterrupt = 0
          McuLossOfLockInterrupt = 0
          McuMDMAPSystemResetInterrupt = 0
          McuResetDelayTime = DELAY_10_LPO_CYCLES
          McuSoftwareInterrupt = 0
          McuStopAcknowledgeErrorInterrupt = 0
          McuWatchdogInterrupt = 0
      McuSIMConfig
        McuAdcOptionsConfiguration:
          McuADC0PreTrigeerSourceSelect = PDB_PRE_TRIGGER
          McuADC0SoftwarePreTrigeerSourceSelect = SW_PRE_TRIGGER_DISABLE
          McuADC0TrigeerSourceSelect = PDB
          McuADC1PreTrigeerSourceSelect = PDB_PRE_TRIGGER
          McuADC1SoftwarePreTrigeerSourceSelect = SW_PRE_TRIGGER_DISABLE
          McuADC1TrigeerSourceSelect = PDB
          McuSoftwareTriggerToTRGMUX = 0
        McuChipControlConfiguration:
          McuAdcSupply = VDD
          McuEnableAdcSupplyMonitoring = 0
          McuPDBBackToBackSelect = 0
          McuPTB0InterleaveChannelSelect = 0
          McuPTB13InterleaveChannelSelect = 0
          McuPTB14InterleaveChannelSelect = 0
          McuPTB1InterleaveChannelSelect = 0
        McuFlexTimerConfiguration:
          McuFTM0Ch{0..7}ModulationSelect = 0
          McuFTM0ExternalClockPinSelect = TCLK0_PIN
          McuFTM0Fault{0..2}Select = FTM0_FLT{0..2}_PIN
          McuFTM0OBEControl = 0
          McuFTM0SyncBit = 0
          McuFTM1Ch0InputSelect = FTM1_CH0_INPUT
          McuFTM1ExternalClockPinSelect = TCLK0_PIN
          McuFTM1Fault{0..2}Select = FTM1_FLT{0..2}_PIN
          McuFTM1OBEControl = 0
          McuFTM1SyncBit = 0
          McuFTM2Ch0InputSelect = FTM2_CH0_INPUT
          McuFTM2Ch1InputSelect = FTM2_CHI1_INPUT
          McuFTM2ExternalClockPinSelect = TCLK0_PIN
          McuFTM2Fault{0..2}Select = FTM2_FLT{0..2}_PIN
          McuFTM2OBEControl = 0
          McuFTM2SyncBit = 0
          McuFTM3Ch{0..7}ModulationSelect = 0
          McuFTM3ExternalClockPinSelect = TCLK0_PIN
          McuFTM3Fault{0..2}Select = FTM3_FLT{0..2}_PIN
          McuFTM3OBEControl = 0
          McuFTM3SyncBit = 0
          McuFTM4ExternalClockPinSelect = TCLK0_PIN
          McuFTM4OBEControl = 0
          McuFTM4SyncBit = 0
          McuFTM5ExternalClockPinSelect = TCLK0_PIN
          McuFTM5OBEControl = 0
          McuFTM5SyncBit = 0
          McuFTM6ExternalClockPinSelect = TCLK0_PIN
          McuFTM6OBEControl = 0
          McuFTM6SyncBit = 0
          McuFTM7ExternalClockPinSelect = TCLK0_PIN
          McuFTM7OBEControl = 0
          McuFTM7SyncBit = 0
          McuFTMGlobalLoadEnable = 0
          McuFTM_GTBControl = 0
          McuQspiClkSelect = 0
          McuRMII_ClkSelect = 0
          McuRMII_Clk_OBE = 0
    McuPublishedInformation
      15 x McuResetReasonConf:
        MCU_CMU_LOC_RESET: McuResetReason=14
        MCU_CORE_LOCKUP_RESET: McuResetReason=3
        MCU_EXTERNAL_PIN_RESET: McuResetReason=6
        MCU_JTAG_RESET: McuResetReason=4
        MCU_LOSS_OF_CLOCK_RESET: McuResetReason=9
        MCU_LOSS_OF_LOCK_RESET: McuResetReason=8
        MCU_LOW_OR_HIGH_VOLTAGE_DETECT_RESET: McuResetReason=10
        MCU_MDM_AP_SYSTEM_RESET: McuResetReason=1
        MCU_MULTIPLE_RESET_REASON: McuResetReason=12
        MCU_NO_RESET_REASON: McuResetReason=11
        MCU_POWER_ON_RESET: McuResetReason=5
        MCU_RESET_UNDEFINED: McuResetReason=13
        MCU_STOP_ACKNOWLEDGE_ERROR_RESET: McuResetReason=0
        MCU_SW_RESET: McuResetReason=2
        MCU_WATCHDOG_RESET: McuResetReason=7
